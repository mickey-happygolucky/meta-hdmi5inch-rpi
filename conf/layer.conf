## conf/layer.conf
```bitbake
# We have a conf and classes directory, append to BBPATH
BBPATH .= ":${LAYERDIR}"

# We have a recipes directory containing .bb and .bbappend files, add to BBFILES
BBFILES += "${LAYERDIR}/recipes*/*/*.bb \
            ${LAYERDIR}/recipes*/*/*.bbappend"

BBFILE_COLLECTIONS += "hdmi5inch-rpi"
BBFILE_PATTERN_hdmi5inch-rpi := "^${LAYERDIR}/"
BBFILE_PRIORITY_hdmi5inch-rpi = "10"
LAYERDEPENDS_hdmi5inch-rpi = "raspberrypi"
```
